## boards/amd/acp_6_0_adsp/acp_6_0_adsp_defconfig
```kconfig
# Copyright (c) 2026 AMD
# SPDX-License-Identifier: Apache-2.0

CONFIG_GEN_ISR_TABLES=y
CONFIG_GEN_IRQ_VECTOR_TABLE=n
CONFIG_XTENSA_RESET_VECTOR=n
CONFIG_OUTPUT_SYMBOLS=n
CONFIG_MULTI_LEVEL_INTERRUPTS=n
CONFIG_2ND_LEVEL_INTERRUPTS=n
CONFIG_DCACHE_LINE_SIZE_DETECT=n
CONFIG_DCACHE_LINE_SIZE=128
CONFIG_COMP_SRC=n
CONFIG_COMP_FIR=n
CONFIG_COMP_IIR=n
CONFIG_COMP_DCBLOCK=n
CONFIG_COMP_CROSSOVER=n
CONFIG_COMP_DRC=n
CONFIG_COMP_MULTIBAND_DRC=n
CONFIG_COMP_TONE=n
CONFIG_COMP_KPB=n
CONFIG_MAXIM_DSM=n
CONFIG_COMP_ASRC=n
CONFIG_COMP_IGO_NR=n
CONFIG_COMP_COPIER=n
CONFIG_COMP_RTNR=n
CONFIG_COMP_ARIA=n
CONFIG_COMP_BASEFW_IPC4=n
CONFIG_COMP_UP_DOWN_MIXER=n
CONFIG_COMP_TDFB=n
CONFIG_COMP_SEL=n
CONFIG_COMP_MIXER=n
CONFIG_ASRC_SUPPORT_CONVERSION_24000_TO_08000=n
CONFIG_ASRC_SUPPORT_CONVERSION_24000_TO_16000=n
CONFIG_ASRC_SUPPORT_CONVERSION_48000_TO_08000=n
CONFIG_ASRC_SUPPORT_CONVERSION_48000_TO_11025=n
CONFIG_ASRC_SUPPORT_CONVERSION_48000_TO_12000=n
CONFIG_ASRC_SUPPORT_CONVERSION_48000_TO_16000=n
CONFIG_ASRC_SUPPORT_CONVERSION_48000_TO_16000=n
CONFIG_ASRC_SUPPORT_CONVERSION_48000_TO_22050=n
CONFIG_ASRC_SUPPORT_CONVERSION_48000_TO_24000=n
CONFIG_ASRC_SUPPORT_CONVERSION_48000_TO_32000=n
CONFIG_ASRC_SUPPORT_CONVERSION_48000_TO_44100=n
```

## boards/amd/acp_7_0_adsp/acp_7_0_adsp_defconfig
```kconfig
# Copyright (c) 2026 AMD
# SPDX-License-Identifier: Apache-2.0

CONFIG_GEN_ISR_TABLES=y
CONFIG_GEN_IRQ_VECTOR_TABLE=n
CONFIG_WRAP_ACTUAL_POSITION=y
CONFIG_DYNAMIC_INTERRUPTS=y
CONFIG_GEN_ISR_TABLES=y
CONFIG_GEN_SW_ISR_TABLE=y
CONFIG_SHARED_INTERRUPTS=n
CONFIG_MULTI_LEVEL_INTERRUPTS=n
CONFIG_ZEPHYR_LOG=n
CONFIG_DAI=y
CONFIG_DMA=y
CONFIG_DMA_DOMAIN=n
CONFIG_ZEPHYR_NATIVE_DRIVERS=y
CONFIG_XTENSA_TIMER=y
CONFIG_XTENSA_TIMER_ID=0
CONFIG_TICKLESS_KERNEL=y
CONFIG_CACHE_MANAGEMENT=y
CONFIG_DCACHE=y
CONFIG_TRACE=n
CONFIG_HAVE_AGENT=n
CONFIG_COMP_VOLUME=y
CONFIG_COMP_SRC=n
CONFIG_COMP_FIR=n
CONFIG_COMP_IIR=n
CONFIG_COMP_DCBLOCK=n
CONFIG_COMP_CROSSOVER=n
CONFIG_COMP_DRC=n
CONFIG_COMP_MULTIBAND_DRC=n
CONFIG_COMP_TONE=n
CONFIG_COMP_KPB=n
CONFIG_MAXIM_DSM=n
CONFIG_COMP_ASRC=n
CONFIG_COMP_IGO_NR=n
CONFIG_COMP_COPIER=n
CONFIG_COMP_RTNR=n
CONFIG_COMP_ARIA=n
CONFIG_COMP_BASEFW_IPC4=n
CONFIG_COMP_UP_DOWN_MIXER=n
CONFIG_COMP_TDFB=n
CONFIG_COMP_SEL=n
CONFIG_COMP_MIXER=n
CONFIG_ASRC_SUPPORT_CONVERSION_24000_TO_08000=n
CONFIG_ASRC_SUPPORT_CONVERSION_24000_TO_16000=n
CONFIG_ASRC_SUPPORT_CONVERSION_48000_TO_08000=n
CONFIG_ASRC_SUPPORT_CONVERSION_48000_TO_11025=n
CONFIG_ASRC_SUPPORT_CONVERSION_48000_TO_12000=n
CONFIG_ASRC_SUPPORT_CONVERSION_48000_TO_16000=n
CONFIG_ASRC_SUPPORT_CONVERSION_48000_TO_16000=n
CONFIG_ASRC_SUPPORT_CONVERSION_48000_TO_22050=n
CONFIG_ASRC_SUPPORT_CONVERSION_48000_TO_24000=n
CONFIG_ASRC_SUPPORT_CONVERSION_48000_TO_32000=n
CONFIG_ASRC_SUPPORT_CONVERSION_48000_TO_44100=n
CONFIG_CORE_COUNT=1
CONFIG_FORMAT_CONVERT_HIFI3=n
```

## drivers/dai/amd/sdw/Kconfig.acp_sdw_dai
```kconfig
# Copyright (c) 2026 AMD
# SPDX-License-Identifier: Apache-2.0

config DAI_AMD_SDW
	bool "AMD SoundWire DAI driver"
		depends on ZEPHYR_NATIVE_DRIVERS
	help
	  Select this to enable AMD SoundWire DAI driver.
```

## drivers/interrupt_controller/Kconfig.acp
```kconfig
# Copyright (c) 2026 AMD
# SPDX-License-Identifier: Apache-2.0

menuconfig INTC_AMD_ACP
	bool "AMD ACP interrupt controller driver"
	default y
	depends on ZEPHYR_NATIVE_DRIVERS
	help
	  Enable support for AMD Audio Co-Processor (ACP) interrupt controller.
	  This driver manages interrupt handling for ACP 7.0 audio subsystem,
	  supporting up to 9 interrupt sources including DMA, SoundWire, and
	  other audio-related peripheral interrupts for AMD audio DSP.

if INTC_AMD_ACP

config INTC_AMD_ACP_INIT_PRIORITY
	int "Initialization priority"
	default 40
	help
	  ACP interrupt controller initialization priority.

config INTC_AMD_ACP_ISR_TBL_OFFSET
	int "Offset in the SW ISR table"
	default 0
	help
	  This indicates the offset in the SW_ISR_TABLE beginning from where
	  the ISRs for ACP interrupt controller are assigned.

endif # INTC_AMD_ACP
```

## dts/bindings/dma/amd,acp-sdw-dma.yaml
```yaml
# Copyright (c) 2026 AMD
# SPDX-License-Identifier: Apache-2.0

description: AMD SOF SoundWire DMA node

compatible: "amd,acp-sdw-dma"
properties:
  reg:
    required: false
    type: array
    description: Register address and size of the DMA controller

  interrupts:
    required: false
    type: array
    description: Interrupt specifier for the DMA controller

  dma-channels:
    type: int
    required: false
    description: Number of DMA channels supported

  dma-requests:
    type: int
    required: false
    description: Number of DMA requests supported

  clocks:
    type: phandle-array
    required: false
    description: Clock(s) for the DMA controller
```

## soc/amd/acp_7_0/Kconfig
```kconfig
# Copyright (c) 2026 AMD
# SPDX-License-Identifier: Apache-2.0

config SOC_ACP_7_0
	select XTENSA
	select XT_INTERRUPT_LEVEL_5
	select XT_INTERRUPT_LEVEL_3
	select XT_INTERRUPT_LEVEL_1
	select XT_INTERRUPT_LEVEL_4
	select XT_WAITI_DELAY
	select XTENSA_EXCLUSIVE
	select AMD
	select AMD_BINARY_BUILD
	select XTENSA_HAL if ("$(ZEPHYR_TOOLCHAIN_VARIANT)" != "xcc" && "$(ZEPHYR_TOOLCHAIN_VARIANT)" != "xt-clang")
	select ATOMIC_OPERATIONS_C
```

## soc/amd/acp_7_0/Kconfig.defconfig
```kconfig
# Copyright (c) 2026 AMD
# SPDX-License-Identifier: Apache-2.0

if SOC_ACP_7_0

config DCACHE
	default y

choice CACHE_TYPE
	default ARCH_CACHE
endchoice

config DCACHE_LINE_SIZE
	default 128

config CACHE_MANAGEMENT
	default y

config XTENSA_TIMER
	default y

config SYS_CLOCK_HW_CYCLES_PER_SEC
	default 600000000

config KERNEL_ENTRY
	default "__start"

endif # SOC_ACP_7_0
```
